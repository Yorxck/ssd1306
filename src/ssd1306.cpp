#include "ssd1306.h"
#include "graphics.h"
#include <Arduino.h>
#include <Wire.h>

ssd1306::ssd1306(uint8_t __width, uint8_t __height, uint8_t __addr, uint8_t __sda, uint8_t __scl, uint8_t __rst) {
  WIDTH = __width;
  HEIGHT = __height;
  addr = __addr;
  rst = __rst;

  #ifdef defined(ESP8266) || defined(ESP32)
    Wire.setPins(__sda, __scl);
  #endif
}

void ssd1306::cmd(uint8_t cmd1) {
  Wire.beginTransmission(addr);
  Wire.write(0x00);
  Wire.write(cmd1);
  Wire.endTransmission();
}

void ssd1306::cmd(uint8_t cmd1, uint8_t cmd2) {
  Wire.beginTransmission(addr);
  Wire.write(0x00);
  Wire.write(cmd1);
  Wire.write(cmd2);
  Wire.endTransmission();
}

void ssd1306::cmd(uint8_t cmd1, uint8_t cmd2, uint8_t cmd3) {
  Wire.beginTransmission(addr);
  Wire.write(0x00);
  Wire.write(cmd1);
  Wire.write(cmd2);
  Wire.write(cmd3);
  Wire.endTransmission();
}

bool ssd1306::begin() {
  if (rst != -1) {
    pinMode(rst, OUTPUT);
    digitalWrite(rst, HIGH);
		delay(1);
		digitalWrite(rst, LOW);
		delay(1);
		digitalWrite(rst, HIGH);
		delay(1);
  }

  Wire.begin();
  Wire.beginTransmission(addr);
  byte err = Wire.endTransmission();
  if (err != 0) {
    errMsg = "device not connected to wire";
    return false;  // didnt find device
  }

  buffer = (uint8_t *)malloc(WIDTH * HEIGHT / 8);
  if (buffer == nullptr) {
    errMsg = "malloc failed";
    return false;  // malloc failed :(
  }
  clear();

  // set display properties
  cmd(DISPLAY_OFF);              //Set display Off
  cmd(0xD5, 0x80);        //Set display clock divide ratio/oscillator frequency
  cmd(0xA8, HEIGHT - 1);  //Set multiplex ratio
  cmd(0xD3, 0x00);        //Set display offset
  cmd(0x40);              //Set display start line
  cmd(0x8D);              //Set charge pump
  cmd(0x14);              //VCC generated by internal DC/DC circuit
  cmd(0xA1);              //Set segment re-map
  cmd(0xC0);              //Set COM output scan direction
  cmd(0xDA, 0x12);        //Set COM pins hardware configuration
  cmd(0x81, 0xCF);        //Set contrast control
  cmd(0xD9, 0xF1);        //Set pre-changed period
  cmd(0xDB, 0x40);        //Set VCOMH Deselected level
  cmd(0xA4);              //Set entire display on/off
  cmd(NORMAL);              //Set normal/inverse display
  cmd(0x20);              //Set memory address mode
  cmd(0x00);              //Horizontal
  cmd(DISPLAY_ON);              //Set display on

  return true;
}

void ssd1306::update() {
  cmd(0x22, 0, 0xFF);
  cmd(0x21, 0, WIDTH-1);

  for (unsigned short q = 0; q < (WIDTH * HEIGHT / 8);) {
    Wire.beginTransmission(addr);
    Wire.write(0x40);
    for (uint8_t w = 0; w < 16; w++) {
      Wire.write(buffer[q]);
      q++;
    }
    Wire.endTransmission();
  }
}

void ssd1306::clear() {
  memset(buffer, 0, WIDTH * HEIGHT / 8);
}

uint8_t ssd1306::width() {
  return WIDTH;
}

uint8_t ssd1306::height() {
  return HEIGHT;
}

char* ssd1306::error() {
  return errMsg;
}

void ssd1306::inverse(bool state) {
  cmd(state ? INVERTED : NORMAL);
}

void ssd1306::on() {
  cmd(DISPLAY_ON);
}

void ssd1306::off() {
  cmd(DISPLAY_OFF);
}

void ssd1306::contrast(uint8_t c) {
  cmd(CONTRAST, c);
}